/* patch_02: aw8697 haptic on i2c11
 * data source: full_cas.dts (runtime FDT) -> /soc/i2c@a8c000/aw8697_haptic@5A
 * notes:
 *   - node name keeps dtc original case @5A
 *   - reset-gpio/irq-gpio use &tlmm (5.10 label), not &qcom-gpio
 *   - no vreg supply (cas DTB does not reference any regulator)
 *   - 5.4 GKI has no built-in aw8697 driver; node is DT-only placeholder
 *   - multi-line cell arrays: no backslash continuation (dtc does not support it)
 */

&i2c11 {
	aw8697_haptic@5A {
		compatible = "awinic,aw8697_haptic";
		reg = <0x5a>;
		reset-gpio = <&tlmm 130 0>;
		irq-gpio = <&tlmm 129 0>;
		vib_mode = <0x00>;
		vib_f0_pre = <0x6a4>;
		vib_f0_cali_percen = <0x07>;
		vib_cont_drv_lev = <0x26>;
		vib_cont_drv_lvl_ov = <0x32>;
		vib_cont_td = <0xf06c>;
		vib_cont_zc_thr = <0x8f8>;
		vib_cont_num_brk = <0x03>;
		vib_f0_coeff = <0x104>;
		vib_f0_trace_parameter = <0x09 0x03 0x01 0x1f>;
		vib_bemf_config = <0x00 0x08 0x03 0xf8>;
		vib_sw_brake = <0x2c>;
		vib_tset = <0x12>;
		vib_r_spare = <0x68>;
		vib_bstdbg = <0x30 0xeb 0xd4 0x00 0x00 0x00>;
		vib_effect_id_boundary = <0x0a>;
		vib_effect_max = <0xc1>;
		vib_trig_config = <0x00 0x01 0x00 0x01 0x02 0x00 0x01 0x00 0x01 0x02 0x00 0x01 0x00 0x01 0x02>;
		vib_bst_vol_default = <0x10>;
		vib_bst_vol_ram = <0x10>;
		vib_bst_vol_rtp = <0x10>;
		vib_rtp_time = <0x14 0x14 0x14 0x14 0x14 0x14 0x14 0x14
				0x4e20 0x3a98 0x3a98 0x4e20 0x61a8 0x3a98 0x7530 0x61a8
				0x4e20 0x4e20 0x4e20 0x4e20 0x4e20 0x4e20 0x4e20 0x4e20
				0x4e20 0x4e20 0x4e20 0x4e20 0x4e20 0x4e20 0x4e20 0x4e20
				0x4e20 0x4e20 0x4e20 0x4e20 0x4e20 0x4e20 0x4e20 0x4e20
				0x4e20 0x4e20 0x4e20 0x4e20 0x4e20 0x4e20 0x4e20 0x4e20
				0x4e20 0x4e20 0x4e20 0x4e20 0x4e20 0x4e20 0x4e20 0x4e20
				0x4e20 0x4e20 0x4e20 0x4e20 0x4e20 0x4e20 0x4e20 0x4e20
				0x4e20 0x4e20 0x4e20 0x4e20 0x4e20 0x4e20 0x4e20 0x4e20
				0x4e20 0x4e20 0x4e20 0x4e20 0x4e20 0x4e20 0x4e20 0x4e20
				0x4e20 0x4e20 0x4e20 0x4e20 0x4e20 0x4e20 0x4e20 0x4e20
				0x4e20 0x4e20 0x4e20 0x4e20 0x4e20 0x4e20 0x4e20 0x4e20
				0x4e20 0x4e20 0x4e20 0x4e20 0x4e20 0x4e20 0x4e20 0x4e20
				0x4e20 0x4e20 0x4e20 0x4e20 0x4e20 0x4e20 0x4e20 0x4e20
				0x4e20 0x4e20 0x4e20 0x4e20 0x4e20 0x4e20 0x4e20 0x4e20
				0x4e20 0x4e20 0x4e20 0x4e20 0x4e20 0x4e20 0x4e20 0x4e20>;
		status = "okay";
	};
};