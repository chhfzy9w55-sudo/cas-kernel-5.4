/*
 * patch_02_v1.dts
 * 添加 aw8697_haptic 振动马达到 I2C 总线 11
 *
 * 数据来源: full_cas.dts (/sys/firmware/fdt 运行时快照)
 *           → /soc/i2c@a8c000/aw8697_haptic@5A
 *
 * 修正说明:
 *   1) 节点名使用 dtc 原始大小写 @5A (不是 @5a)
 *   2) reset-gpio / irq-gpio 引用 &tlmm (5.10 label, 非 &qcom-gpio)
 *   3) 保留 status = "okay" (非 cas DTB 里的 "ok")
 *   4) vib_rtp_time 保持数组属性形式（cas DTB 原样）
 *   5) 无 vreg-supply 属性（cas DTB 中确实不引用 regulator）
 *   6) 5.4 GKI 无内建 aw8697 驱动, 节点仅作 DT 占位; dtbs 编译不受影响
 */

&i2c11 {
	aw8697_haptic@5A {
		compatible = "awinic,aw8697_haptic";
		reg = <0x5a>;
		reset-gpio = <&tlmm 130 0>;
		irq-gpio = <&tlmm 129 0>;
		vib_mode = <0x00>;
		vib_f0_pre = <0x6a4>;
		vib_f0_cali_percen = <0x07>;
		vib_cont_drv_lev = <0x26>;
		vib_cont_drv_lvl_ov = <0x32>;
		vib_cont_td = <0xf06c>;
		vib_cont_zc_thr = <0x8f8>;
		vib_cont_num_brk = <0x03>;
		vib_f0_coeff = <0x104>;
		vib_f0_trace_parameter = <0x09 0x03 0x01 0x1f>;
		vib_bemf_config = <0x00 0x08 0x03 0xf8>;
		vib_sw_brake = <0x2c>;
		vib_tset = <0x12>;
		vib_r_spare = <0x68>;
		vib_bstdbg = <0x30 0xeb 0xd4 0x00 0x00 0x00>;
		vib_effect_id_boundary = <0x0a>;
		vib_effect_max = <0xc1>;
		vib_trig_config = <0x00 0x01 0x00 0x01 0x02 0x00 0x01 0x00 0x01 0x02 0x00 0x01 0x00 0x01 0x02>;
		vib_bst_vol_default = <0x10>;
		vib_bst_vol_ram = <0x10>;
		vib_bst_vol_rtp = <0x10>;
		vib_rtp_time = <0x14 0x14 0x14 0x14 0x14 0x14 0x14 0x14 \
				0x4e20 0x3a98 0x3a98 0x4e20 0x61a8 0x3a98 0x7530 0x61a8 \
				0x4e20 0x4e20 0x4e20 0x4e20 0x4e20 0x4e20 0x4e20 0x4e20 \
				0x4e20 0x4e20 0x4e20 0x4e20 0x4e20 0x4e20 0x4e20 0x4e20 \
				0x4e20 0x4e20 0x4e20 0x4e20 0x4e20 0x4e20 0x4e20 0x4e20 \
				0x4e20 0x4e20 0x4e20 0x4e20 0x4e20 0x4e20 0x4e20 0x4e20 \
				0x4e20 0x4e20 0x4e20 0x4e20 0x4e20 0x4e20 0x4e20 0x4e20 \
				0x4e20 0x4e20 0x4e20 0x4e20 0x4e20 0x4e20 0x4e20 0x4e20 \
				0x4e20 0x4e20 0x4e20 0x4e20 0x4e20 0x4e20 0x4e20 0x4e20 \
				0x4e20 0x4e20 0x4e20 0x4e20 0x4e20 0x4e20 0x4e20 0x4e20 \
				0x4e20 0x4e20 0x4e20 0x4e20 0x4e20 0x4e20 0x4e20 0x4e20 \
				0x4e20 0x4e20 0x4e20 0x4e20 0x4e20 0x4e20 0x4e20 0x4e20 \
				0x4e20 0x4e20 0x4e20 0x4e20 0x4e20 0x4e20 0x4e20 0x4e20 \
				0x4e20 0x4e20 0x4e20 0x4e20 0x4e20 0x4e20 0x4e20 0x4e20 \
				0x4e20 0x4e20 0x4e20 0x4e20 0x4e20 0x4e20 0x4e20 0x4e20 \
				0x4e20 0x4e20 0x4e20 0x4e20 0x4e20 0x4e20 0x4e20 0x4e20>;
		status = "okay";
	};
};
